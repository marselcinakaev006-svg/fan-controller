#include "UART.h"
#include <avr/io.h>
#include <avr/interrupt.h>

// ====================================================================
//  ПЕРЕДАЮЩИЙ БУФЕР
// ====================================================================

volatile char tx_buffer[TX_BUFFER_SIZE];
volatile uint8_t tx_head = 0;    // Указатель записи
volatile uint8_t tx_tail = 0;    // Указатель чтения
volatile uint8_t tx_busy = 0;    // 1 = передача активна

// ====================================================================
//  ПРИЁМНЫЙ БУФЕР
// ====================================================================

volatile char rx_buffer[RX_BUFFER_SIZE];
volatile uint8_t rx_index = 0;
volatile uint8_t rx_complete = 0;

// ====================================================================
//  ИНИЦИАЛИЗАЦИЯ UART
// ====================================================================

void usart_init(void)
{
	UBRRH = 0;
	UBRRL = 103;   // 9600 бод при 16 МГц

	// RXEN — приём, TXEN — передача, RXCIE — прерывание приёма
	UCSRB = (1 << RXEN) | (1 << TXEN) | (1 << RXCIE);

	// 8 бит данных, 1 стоп-бит, без чётности
	UCSRC = (1 << URSEL) | (1 << UCSZ1) | (1 << UCSZ0);
}

// ====================================================================
//  ДОБАВИТЬ БАЙТ В ПЕРЕДАЮЩИЙ БУФЕР
// ====================================================================

void usart_transmit_byte(uint8_t data)
{
	// Если буфер полон — ждём (можно сделать без ожидания, но надёжнее так)
	while ((tx_head + 1) % TX_BUFFER_SIZE == tx_tail);

	// Кладём байт в буфер
	tx_buffer[tx_head] = data;
	tx_head = (tx_head + 1) % TX_BUFFER_SIZE;

	// Если передача ещё не начата — запускаем
	if (!tx_busy)
	{
		tx_busy = 1;
		UCSRB |= (1 << UDRIE);   // Разрешить прерывание "регистр данных пуст"
	}
}

// ====================================================================
//  ДОБАВИТЬ СТРОКУ В ПЕРЕДАЮЩИЙ БУФЕР
// ====================================================================

void usart_transmit_string(const char str[])
{
	int i = 0;
	while (str[i] != '\0')
	{
		usart_transmit_byte(str[i]);
		i++;
	}
}

// ====================================================================
//  ДОЖДАТЬСЯ ОКОНЧАНИЯ ПЕРЕДАЧИ (если нужно)
// ====================================================================

void usart_flush_tx(void)
{
	while (tx_busy)
	;   // Пока идёт передача — стоим
}

// ====================================================================
//  БЛОКИРУЮЩИЙ ПРИЁМ БАЙТА (для старых проектов)
// ====================================================================

uint8_t usart_receive_byte(void)
{
	while (!(UCSRA & (1 << RXC)));
	return UDR;
}

// ====================================================================
//  ОЧИСТКА ПРИЁМНОГО БУФЕРА
// ====================================================================

void clear_rx_buffer(void)
{
	for (uint8_t i = 0; i < RX_BUFFER_SIZE; i++)
	rx_buffer[i] = '\0';
	rx_index = 0;
	rx_complete = 0;
}

// ====================================================================
//  ПРЕРЫВАНИЕ "РЕГИСТР ДАННЫХ ПУСТ" (UDRE)
// ====================================================================

ISR(USART_UDRE_vect)
{
	// Если в буфере есть байты
	if (tx_head != tx_tail)
	{
		UDR = tx_buffer[tx_tail];               // Отправляем байт
		tx_tail = (tx_tail + 1) % TX_BUFFER_SIZE; // Сдвигаем указатель
	}
	else
	{
		// Буфер пуст — прекращаем передачу
		UCSRB &= ~(1 << UDRIE);
		tx_busy = 0;
	}
}

// ====================================================================
//  ПРЕРЫВАНИЕ ПО ПРИЁМУ БАЙТА (RXC)
// ====================================================================

ISR(USART_RXC_vect)
{
	char c = UDR;

	if (c == '\n' || c == '\r')
	{
		rx_buffer[rx_index] = '\0';
		rx_complete = 1;
		rx_index = 0;
	}
	else if (c == '\b' || c == 127)
	{
		if (rx_index > 0)
		{
			rx_index--;
			rx_buffer[rx_index] = '\0';
		}
	}
	else
	{
		if (rx_index < RX_BUFFER_SIZE - 1)
		{
			rx_buffer[rx_index] = c;
			rx_index++;
		}
	}
}